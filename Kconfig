## Kconfig
```kconfig
menu "Sofle Choc Wireless Custom Features"

config ZMK_HUB_LOW_BATTERY_LED
    bool "Blink hub LED when any device battery is low"
    default n
    depends on SHIELD_BLE_CENTRAL_HUB
    help
      Blinks led0 on the BLE hub when either the hub battery or any connected
      peripheral battery is below the configured threshold.

config ZMK_HUB_LOW_BATTERY_THRESHOLD
    int "Low battery threshold percent"
    default 20
    range 1 100
    depends on ZMK_HUB_LOW_BATTERY_LED

config ZMK_HUB_LOW_BATTERY_BLINK_MS
    int "Low battery blink interval in ms"
    default 500
    range 100 5000
    depends on ZMK_HUB_LOW_BATTERY_LED

endmenu
```

## boards/shields/adeptble/Kconfig.defconfig
```kconfig
if SHIELD_ADEPTBLE

config ZMK_BLE
  default y 

config ZMK_POINTING
  default y

config ZMK_SPLIT
  default y

config SPI
	default y

endif
```

## boards/shields/ble_central_hub/Kconfig.defconfig
```kconfig
# Copyright (c) 2026
# SPDX-License-Identifier: MIT

if SHIELD_BLE_CENTRAL_HUB

config ZMK_SPLIT_ROLE_CENTRAL
    default y

config ZMK_SPLIT_BLE_CENTRAL_PERIPHERALS
    default 3

endif
```

## boards/shields/ble_central_hub/Kconfig.shield
```kconfig
# Copyright (c) 2026
# SPDX-License-Identifier: MIT

config SHIELD_BLE_CENTRAL_HUB
    def_bool $(shields_list_contains,ble_central_hub)
```

## boards/shields/sofle_dongle/Kconfig.defconfig
```kconfig
if SHIELD_SOFLE_DONGLE

config ZMK_KEYBOARD_NAME
    default "Sofle Dongle"

config ZMK_SPLIT
    default y

config ZMK_USB
    default y

config ZMK_BLE
    default y

config ZMK_POINTING
    default y

endif
```

## boards/shields/unified_hub/Kconfig.defconfig
```kconfig
# Copyright (c) 2026
# SPDX-License-Identifier: MIT

if SHIELD_UNIFIED_HUB_SOFLE || SHIELD_UNIFIED_HUB_ADEPTBLE

config ZMK_SPLIT_ROLE_CENTRAL
    default y

config ZMK_SPLIT_BLE_CENTRAL_PERIPHERALS
    default 1

endif
```

## boards/shields/unified_hub/Kconfig.shield
```kconfig
# Copyright (c) 2026
# SPDX-License-Identifier: MIT

config SHIELD_UNIFIED_HUB_SOFLE
    def_bool $(shields_list_contains,unified_hub_sofle)

config SHIELD_UNIFIED_HUB_ADEPTBLE
    def_bool $(shields_list_contains,unified_hub_adeptble)
```

## config/west.yml
```yaml
manifest:
  remotes:
    - name: zmkfirmware
      url-base: https://github.com/zmkfirmware
    - name: bildermankawasaki
      url-base: https://github.com/BildermanKawasaki
  projects:
    - name: zmk
      remote: zmkfirmware
      revision: main
      import: app/west.yml
    - name: zmk-device-adeptble-trackball
      remote: bildermankawasaki
      revision: main
  self:
    path: config
```
