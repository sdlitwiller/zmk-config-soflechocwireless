// Board-level overlay applied before any shield overlays.
// Defines the pro_micro labels required by the Sofle shield before they are
// referenced, since DTC requires labels to be defined prior to use.
/ {
    pro_micro: pro_micro_connector {
        compatible = "arduino-pro-micro";
        #gpio-cells = <2>;
        gpio-map-mask = <0xffffffff 0xffffffc0>;
        gpio-map-pass-thru = <0 0x3f>;
        gpio-map
            = <5 0 &gpio0 4 0>
            , <6 0 &gpio0 10 0>
            , <7 0 &gpio0 5 0>
            , <8 0 &gpio0 2 0>
            , <9 0 &gpio1 11 0>
            , <10 0 &gpio1 12 0>
            , <14 0 &gpio1 13 0>
            , <15 0 &gpio1 5 0>
            , <16 0 &gpio1 3 0>
            , <18 0 &gpio1 14 0>
            , <19 0 &gpio1 7 0>
            , <20 0 &gpio0 28 0>
            , <21 0 &gpio1 1 0>
            ;
    };
};

pro_micro_i2c: &xiao_i2c {};
