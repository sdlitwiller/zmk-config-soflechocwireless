#include <physical_layouts.dtsi>

/{
    adeptble_layout: adeptble_layout {
      compatible = "zmk,physical-layout";
      display-name = "Default";

      keys  //                     w   h   x   y   rot   rx   ry
          = <&key_physical_attrs  18  43   0   0     0    0    0>
          , <&key_physical_attrs  20  24  21   0     0    0    0>
          , <&key_physical_attrs  20  24  46   0     0    0    0>
          , <&key_physical_attrs  18  43  71   0     0    0    0>
          , <&key_physical_attrs  20  24   0  46     0    0    0>
          , <&key_physical_attrs  18  43  71  46     0    0    0>
    };
};
