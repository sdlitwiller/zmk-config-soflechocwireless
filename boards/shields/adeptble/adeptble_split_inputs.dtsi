/ {
    split_inputs {
        #address-cells = <1>;
        #size-cells = <0>;

        adeptble_trackball_split: adeptble_trackball_split@0 {
            compatible = "zmk,input-split";
            reg = <0>;
        };
    };

    adeptble_trackball_listener: adeptble_trackball_listener {
        compatible = "zmk,input-listener";
        status = "disabled";
        device = <&adeptble_trackball_split>;
    };
};
